## config/west.yml
```yaml
manifest:
  remotes:
    - name: zmkfirmware
      url-base: https://github.com/zmkfirmware
    - name: cornix-shield
      url-base: https://github.com/hitsmaxft
    - name: englmaxi
      url-base: https://github.com/englmaxi
    - name: caksoylar
      url-base: https://github.com/caksoylar
    - name: urob
      url-base: https://github.com/urob


  projects:
    - name: zmk
      remote: zmkfirmware
      revision: main
      import:
        file: app/west.yml

    - name: zmk-keyboard-cornix
      remote: cornix-shield
      revision: main

    - name: zmk-dongle-display
      remote: englmaxi
      revision: main

    - name: zmk-dongle-screen
      remote: cornix-shield
      revision: main

    - name: zmk-rgbled-widget
      remote: caksoylar
      revision: main

    - name: zmk-helpers          # ← NEW!
      remote: urob               # ← 上で追加した remotes を参照
      revision: main

  self:
    path: config


  self:
    path: config
```
